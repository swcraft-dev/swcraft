AUTOSAR XML (schema 4-2-2)
package /Acme/Types
  base type Word: category=FIXED_LENGTH, base-type-size=16, base-type-encoding=NONE, native-declaration=uint16
  impl type RawTemp: category=VALUE, base-type=Word
  app type Temperature: category=VALUE
package /Acme/Mappings
  data type mapping set Maps
    data-type-maps:
      application-data-type=Temperature, implementation-data-type=RawTemp
      application-data-type=Humidity, implementation-data-type=RawHumidity
package /Acme/Interfaces
  sender receiver interface ITemperature
    data temperature: type=Temperature
package /Acme/Components
  application sw component type TempSwc
    provide port pTemperature: provided-interface=ITemperature
    behavior TempSwcBehavior: data-type-mapping=[Maps, PlatformMaps], handle-termination-and-restart=NO-SUPPORT
  composition sw component type Root
    component tempSwc: type=TempSwc
