AUTOSAR XML (schema 4-2-2)
package /Acme/Chassis/Types
  impl type Level: category=VALUE, base-type=Word
package /Acme/Chassis/AppTypes
  application record data type StatusRecord: category=STRUCTURE
    application record element flag: category=VALUE, type=AbsentFieldType
  application array data type StatusArray: category=ARRAY
    element entry: category=VALUE, type=AbsentItemType, max-number-of-elements=4
package /Acme/Chassis/Interfaces
  sender receiver interface ILevel
    data level: type=AbsentElementType
package /Acme/Chassis/Components
  application sw component type ReporterSwc
    provide port pStatus: provided-interface=AbsentProvidedInterface
    behavior ReporterSwc_InternalBehavior: handle-termination-and-restart=NO-SUPPORT
package /Acme/Chassis/Compositions
  composition sw component type Root
    provide port pOuterStatus: provided-interface=AbsentOuterInterface
    component ReporterPart: type=ReporterSwc
