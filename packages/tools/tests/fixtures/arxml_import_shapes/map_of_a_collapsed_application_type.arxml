AUTOSAR XML (schema 4-2-2)
package /Acme/BaseTypes
  base type Word: category=FIXED_LENGTH, base-type-size=16, base-type-encoding=NONE, native-declaration=uint16
package /Acme/ImplTypes
  impl type Level: category=VALUE, base-type=Word
  impl type RawAngle: category=VALUE, base-type=Word
package /Acme/AppTypes
  app type Level: category=VALUE
  app type Angle: category=VALUE, unit=deg
  unit Degree: display-name=deg
package /Acme/Mappings
  data type mapping set Maps
    data-type-maps:
      application-data-type=Level, implementation-data-type=Level
      application-data-type=Angle, implementation-data-type=RawAngle
package /Acme/Interfaces
  sender receiver interface ILevel
    data level: type=Level
    data angle: type=Angle
package /Acme/Components
  application sw component type LevelSwc
    provide port pLevel: provided-interface=ILevel
    behavior LevelSwcBehavior: data-type-mapping=Maps, handle-termination-and-restart=NO-SUPPORT
  composition sw component type Root
    component levelSwc: type=LevelSwc
