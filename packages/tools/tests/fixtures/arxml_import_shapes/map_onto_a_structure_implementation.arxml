AUTOSAR XML (schema 4-2-2)
package /Acme/Types
  base type Word: category=FIXED_LENGTH, base-type-size=16, base-type-encoding=NONE, native-declaration=uint16
  impl type RawScalar: category=VALUE, base-type=Word
  impl type RawPair: category=STRUCTURE
  app type Distance: category=VALUE
  application record data type Span
    application record element from: type=Distance
    application record element to: type=Distance
package /Acme/Mappings
  data type mapping set Maps
    data-type-maps:
      application-data-type=Span, implementation-data-type=RawPair
      application-data-type=Distance, implementation-data-type=RawScalar
package /Acme/Interfaces
  sender receiver interface ISpan
    data span: type=Span
package /Acme/Components
  application sw component type SpanSource
    provide port pSpan: provided-interface=ISpan
    behavior SpanSourceBehavior: data-type-mapping=Maps, handle-termination-and-restart=NO-SUPPORT
  composition sw component type Root
    component source: type=SpanSource
