AUTOSAR XML (schema 4-2-2)
package /Acme/Left/Compositions
  composition sw component type Upper
    component LowerPart: type=Compositions/Lower
  composition sw component type Lower
    component UpperPart: type=Compositions/Upper
package /Acme/Right/Compositions
  composition sw component type Upper
    component LowerPart: type=Compositions/Lower
  composition sw component type Lower
    component UpperPart: type=Compositions/Upper
