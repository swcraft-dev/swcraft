AUTOSAR XML (schema 4-2-2)
package /Acme/BaseTypes
  base type Word: category=FIXED_LENGTH, base-type-size=16, base-type-encoding=NONE, native-declaration=uint16
package /Acme/ImplTypes
  impl type Angle: category=VALUE, base-type=Word
  impl type Angle_impl: category=VALUE, base-type=Word
package /Acme/AppTypes
  unit AngleUnit: display-name=deg
  app type Angle: category=VALUE, compu {phys=raw*0.01}, range phys -180..180, unit=deg
package /Acme/Mappings
  data type mapping set TypeMaps: data-type-map{application-data-type=Angle, implementation-data-type=Angle}
package /Acme/Interfaces
  sender receiver interface IAngle
    data angle: type=Angle
    data spare: type=Angle_impl
package /Acme/Components
  application sw component type AngleSwc
    provide port pAngle: provided-interface=IAngle
