AUTOSAR XML (schema 4-2-2)
package /Acme/TreeA/Types
  base type Word: category=FIXED_LENGTH, base-type-size=16, base-type-encoding=NONE, native-declaration=uint16
  impl type Ratio: category=VALUE, base-type=Types/Word
package /Acme/TreeB/Types
  base type Word: category=FIXED_LENGTH, base-type-size=32, base-type-encoding=NONE, native-declaration=uint16
  impl type Ratio: category=VALUE, base-type=Types/Word
package /Acme/App/Interfaces
  sender receiver interface IRatio
    data ratio: type=Types/Ratio
package /Acme/App/Components
  application sw component type RatioSwc
    provide port pRatio: provided-interface=IRatio
    behavior RatioSwc_InternalBehavior: handle-termination-and-restart=NO-SUPPORT
