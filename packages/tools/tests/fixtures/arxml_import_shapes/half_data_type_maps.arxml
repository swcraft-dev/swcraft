AUTOSAR XML (schema 4-2-2)
package /Acme/Types
  base type Word: category=FIXED_LENGTH, base-type-size=16, base-type-encoding=NONE, native-declaration=uint16
  impl type RawTemp: category=VALUE, base-type=Word
  impl type RawHumidity: category=VALUE, base-type=Word
  app type Temperature: category=VALUE
  app type Humidity: category=VALUE
package /Acme/Mappings
  data type mapping set Maps: data-type-maps=[{application-data-type=Temperature, implementation-data-type=RawTemp}, Humidity, RawHumidity]
package /Acme/Interfaces
  sender receiver interface IClimate
    data temperature: type=Temperature
package /Acme/Components
  application sw component type ClimateSwc
    provide port pClimate: provided-interface=IClimate
    behavior ClimateSwcBehavior: data-type-mapping=Maps, handle-termination-and-restart=NO-SUPPORT
  composition sw component type Root
    component climateSwc: type=ClimateSwc
