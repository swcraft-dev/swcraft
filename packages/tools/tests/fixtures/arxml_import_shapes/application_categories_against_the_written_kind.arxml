AUTOSAR XML (schema 4-2-2)
package /Acme/Types
  base type Word: category=FIXED_LENGTH, base-type-size=16, base-type-encoding=NONE, native-declaration=uint16
  impl type RawCount: category=VALUE, base-type=Word
  unit CadenceUnit: display-name=rpm
  5 x app type:
    Gear: category=VALUE, compu {0=LOW, 1=HIGH}
    Cadence: category=TEXTTABLE, compu {phys=raw*0.5}, unit=rpm
    Mode: category=TEXTTABLE, compu {0=IDLE, 1=RUN}
    Torque: category=VALUE
    Level
package /Acme/Mappings
  data type mapping set SignalMaps
    data-type-maps:
      application-data-type=Gear, implementation-data-type=RawCount
      application-data-type=Cadence, implementation-data-type=RawCount
      application-data-type=Mode, implementation-data-type=RawCount
      application-data-type=Torque, implementation-data-type=RawCount
      application-data-type=Level, implementation-data-type=RawCount
package /Acme/Interfaces
  sender receiver interface ISignals
    5 x data:
      gear: type=Gear
      cadence: type=Cadence
      mode: type=Mode
      torque: type=Torque
      level: type=Level
package /Acme/Components
  application sw component type SignalSource
    provide port pSignals: provided-interface=ISignals
    behavior SignalSourceBehavior: data-type-mapping=SignalMaps, handle-termination-and-restart=NO-SUPPORT
  application sw component type SignalSink
    require port rSignals: required-interface=ISignals
    behavior SignalSinkBehavior: data-type-mapping=SignalMaps, handle-termination-and-restart=NO-SUPPORT
  composition sw component type Root
    component source: type=SignalSource
    component sink: type=SignalSink
