AUTOSAR XML (schema 4-2-2)
package /Acme/BaseTypes
  base type Word: category=FIXED_LENGTH, base-type-size=16, base-type-encoding=NONE, native-declaration=uint16
package /Acme/AppTypes
  unit FlowUnit: display-name=l/min
  app type Flow: category=VALUE, compu {phys=raw}, range phys 0..60, unit=l/min
package /Acme/Interfaces
  sender receiver interface IFlow
    data flow: type=Flow
package /Acme/Components
  application sw component type FlowSwc
    provide port pFlow: provided-interface=IFlow
