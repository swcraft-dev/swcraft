AUTOSAR XML (schema 4-2-2)
package /Acme/Left
  base type Word: category=FIXED_LENGTH, base-type-size=16, base-type-encoding=NONE, native-declaration=uint16
  impl type RawFlow: category=VALUE, base-type=Left/Word
  app type Flow: category=VALUE
  data type mapping set Maps: data-type-map{application-data-type=Left/Flow, implementation-data-type=Left/RawFlow}
package /Acme/Right
  base type Word: category=FIXED_LENGTH, base-type-size=16, base-type-encoding=NONE, native-declaration=uint16
  impl type RawFlow: category=VALUE, base-type=Right/Word
  app type Flow: category=VALUE
  data type mapping set Maps: data-type-map{application-data-type=Right/Flow, implementation-data-type=Right/RawFlow}
package /Acme/App
  sender receiver interface IFlow
    data flow: type=Left/Flow
  application sw component type FlowSwc
    provide port pFlow: provided-interface=IFlow
    behavior FlowSwcBehavior: data-type-mapping=Left/Maps, handle-termination-and-restart=NO-SUPPORT
  composition sw component type Root
    component flowSwc: type=FlowSwc
