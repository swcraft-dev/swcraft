AUTOSAR XML (schema 4-2-2)
package /Acme/Left/AppTypes
  app type GearStateEnum: category=VALUE, compu {0=PARK, 1=DRIVE}
package /Acme/Right/AppTypes
  app type GearStateEnum: category=VALUE, compu {0=PARK, 1=DRIVE}
