AUTOSAR XML (schema 4-2-2)
package /Acme/Left/Types
  base type Byte8: category=FIXED_LENGTH, base-type-size=8, base-type-encoding=NONE, native-declaration=uint8
  impl type Level: category=VALUE, base-type=Types/Byte8
package /Acme/Left/Interfaces
  sender receiver interface ILevel
    data level: type=Types/Level
package /Acme/Right/Types
  base type Byte8: category=FIXED_LENGTH, base-type-size=8, base-type-encoding=NONE, native-declaration=uint8
  impl type Level: category=VALUE, base-type=Types/Byte8
package /Acme/Right/Interfaces
  sender receiver interface ILevel
    data level: type=Types/Level
