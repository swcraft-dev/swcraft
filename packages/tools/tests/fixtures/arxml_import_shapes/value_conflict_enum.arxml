AUTOSAR XML (schema 4-2-2)
package /Acme/Left/AppTypes
  app type DriveModeEnum: category=VALUE, compu {0=IDLE, 1=CREEP, 2=CRUISE, 3=SPORT, 4=LIMP}
package /Acme/Right/AppTypes
  app type DriveModeEnum: category=VALUE, compu {0=IDLE, 1=CREEP, 2=CRUISE, 3=SPORT}
