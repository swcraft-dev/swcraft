AUTOSAR XML (schema 4-2-2)
package /Acme/Chassis/Types
  base type Octet: category=FIXED_LENGTH, base-type-size=8, base-type-encoding=NONE, native-declaration=uint8
  impl type Level: category=VALUE, base-type=Octet
package /Acme/Chassis/Interfaces
  client server interface ICalibrationService
    operation Calibrate
      arg request: type=Level, direction=IN
      arg result: type=AbsentResultType, direction=OUT
