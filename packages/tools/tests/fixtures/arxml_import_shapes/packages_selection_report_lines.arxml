AUTOSAR XML (schema 4-2-2)
package /Acme/Kept/Types
  base type Word: category=FIXED_LENGTH, base-type-size=16, base-type-encoding=NONE, native-declaration=uint16
  impl type Level: category=VALUE, base-type=Word
  impl type Pressure: category=VALUE, base-type=Word
package /Acme/Kept/AppTypes
  app type Level: category=VALUE
  app type Pressure: category=VALUE
package /Acme/Kept/Arrays
  application array data type Pressure: category=ARRAY
    element sample: category=VALUE, type=Pressure, array-size-semantics=FIXED-SIZE, max-number-of-elements=4
package /Acme/Kept/Mappings
  data type mapping set KeptMaps: data-type-map{application-data-type=Level, implementation-data-type=Level}
package /Acme/Kept/Interfaces
  sender receiver interface ILevel
    data level: type=Level
    data pressure: type=Pressure
    data pressures: type=Pressure
package /Acme/Kept/Components
  application sw component type LevelSwc
    provide port pLevel: provided-interface=ILevel
package /Acme/Other/Types
  impl type Gauge: category=VALUE, base-type=Word
  impl type Speed: category=VALUE, base-type=Word
package /Acme/Other/AppTypes
  app type Gauge: category=VALUE
  app type Speed: category=VALUE
package /Acme/Other/Arrays
  application array data type Speed: category=ARRAY
    element sample: category=VALUE, type=Speed, array-size-semantics=FIXED-SIZE, max-number-of-elements=4
package /Acme/Other/Mappings
  data type mapping set OtherMaps: data-type-map{application-data-type=Gauge, implementation-data-type=Gauge}
package /Acme/Other/Interfaces
  sender receiver interface IGauge
    data gauge: type=Gauge
    data speed: type=Speed
    data speeds: type=Speed
package /Acme/Other/Components
  application sw component type GaugeSwc
    provide port pGauge: provided-interface=IGauge
package /Acme/Other/Compositions
  composition sw component type Cluster
    component GaugePart: type=GaugeSwc
    component RemotePart: type=LevelSwc
