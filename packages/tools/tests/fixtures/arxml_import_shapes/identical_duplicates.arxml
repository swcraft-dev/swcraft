AUTOSAR XML (schema 4-2-2)
package /Acme/Common/Types
  base type Octet: category=FIXED_LENGTH, base-type-size=8, base-type-encoding=NONE, native-declaration=uint8
  impl type LevelValue: category=VALUE, base-type=Octet
package /Acme/Left/Types
  base type Flag: category=FIXED_LENGTH, base-type-size=8, base-type-encoding=BOOLEAN, native-declaration=boolean
package /Acme/Left/Interfaces
  sender receiver interface ILevel  # Level reported by the left-hand subsystem (invented fixture text).
    data level: type=LevelValue
package /Acme/Right/Types
  base type Flag: category=FIXED_LENGTH, base-type-size=8, base-type-encoding=BOOLEAN, native-declaration=boolean
package /Acme/Right/Interfaces
  sender receiver interface ILevel  # Level reported by the right-hand subsystem (invented fixture text, deliberately different).
    data level: type=LevelValue
