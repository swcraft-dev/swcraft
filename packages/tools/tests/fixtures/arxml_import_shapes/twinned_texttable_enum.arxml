AUTOSAR XML (schema 4-2-2)
package /Acme/BaseTypes
  base type Byte: category=FIXED_LENGTH, base-type-size=8, base-type-encoding=NONE, native-declaration=uint8
package /Acme/ImplTypes
  impl type DriveMode: category=VALUE, base-type=Byte
package /Acme/AppTypes
  app type DriveMode: category=VALUE, compu {0=OFF, 1=ECO, 2=SPORT}
package /Acme/Mappings
  data type mapping set TypeMaps: data-type-map{application-data-type=DriveMode, implementation-data-type=DriveMode}
package /Acme/Interfaces
  sender receiver interface IDriveMode
    data mode: type=DriveMode
package /Acme/Components
  application sw component type DriveModeSwc
    provide port pMode: provided-interface=IDriveMode
