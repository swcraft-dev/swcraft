AUTOSAR XML (schema 4-2-2)
package /Acme/Chassis/Types
  base type Octet: category=FIXED_LENGTH, base-type-size=8, base-type-encoding=NONE, native-declaration=uint8
  impl type Level: category=VALUE, base-type=Octet
package /Acme/Chassis/Interfaces
  sender receiver interface ILevel
    data level: type=Level
package /Acme/Chassis/Components
  application sw component type LocalSwc
    provide port pLevel: provided-interface=ILevel
package /Acme/Chassis/Compositions
  composition sw component type Root
    component LocalPart: type=LocalSwc
    component RemotePart: type=RemoteSwc
