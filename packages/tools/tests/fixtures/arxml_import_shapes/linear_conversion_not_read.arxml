AUTOSAR XML (schema 4-2-2)
package /Acme/BaseTypes
  base type Word: category=FIXED_LENGTH, base-type-size=16, base-type-encoding=NONE, native-declaration=uint16
package /Acme/AppTypes
  unit RatioUnit: display-name=%
  app type Ratio: category=VALUE, compu {phys=raw*0.25}, range phys 0..100, unit=%
  unit SegmentedUnit: display-name=mm
  app type Segmented: category=VALUE, compu {phys=raw*0.5, phys=raw*0.25+10}, range phys 0..1000, unit=mm
package /Acme/Interfaces
  sender receiver interface IMeasures
    data ratio: type=Ratio
    data segmented: type=Segmented
package /Acme/Components
  application sw component type MeasureSwc
    provide port pMeasures: provided-interface=IMeasures
