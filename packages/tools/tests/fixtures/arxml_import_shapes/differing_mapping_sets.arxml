AUTOSAR XML (schema 4-2-2)
package /Acme/Types
  base type Word: category=FIXED_LENGTH, base-type-size=16, base-type-encoding=NONE, native-declaration=uint16
  impl type RawNarrow: category=VALUE, base-type=Word
  impl type RawWide: category=VALUE, base-type=Word
  app type Flow: category=VALUE
package /Acme/Left
  data type mapping set Maps: data-type-map{application-data-type=Flow, implementation-data-type=RawNarrow}
package /Acme/Right
  data type mapping set Maps: data-type-map{application-data-type=Flow, implementation-data-type=RawWide}
package /Acme/App
  sender receiver interface IFlow
    data flow: type=Flow
  application sw component type FlowSwc
    provide port pFlow: provided-interface=IFlow
    behavior FlowSwcBehavior: data-type-mapping=Left/Maps, handle-termination-and-restart=NO-SUPPORT
  composition sw component type Root
    component flowSwc: type=FlowSwc
