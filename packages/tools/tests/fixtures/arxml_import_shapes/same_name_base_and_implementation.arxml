AUTOSAR XML (schema 4-2-2)
package /Acme/Chassis/BaseTypes
  base type Sample: category=FIXED_LENGTH, base-type-size=16, base-type-encoding=NONE, native-declaration=uint16
package /Acme/Chassis/ImplTypes
  impl type Sample: category=VALUE, base-type=Sample
