AUTOSAR XML (schema 4-2-2)
package /Acme/Present/Types
  base type Word16: category=FIXED_LENGTH, base-type-size=16, base-type-encoding=NONE, native-declaration=uint16
  impl type SpeedValue: category=VALUE, base-type=Word16  # An unrelated element that happens to carry the short name the dangling reference ends in (invented fixture).
package /Acme/Present/Interfaces
  sender receiver interface ISpeed
    data speed: type=SpeedValue
