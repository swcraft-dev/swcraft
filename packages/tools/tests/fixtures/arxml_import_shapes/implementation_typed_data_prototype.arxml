AUTOSAR XML (schema 4-2-2)
package /Acme/BaseTypes
  base type Word: category=FIXED_LENGTH, base-type-size=16, base-type-encoding=NONE, native-declaration=uint16
package /Acme/ImplTypes
  impl type Counter: category=VALUE, base-type=Word
  impl type RawPressure: category=VALUE, base-type=Word
package /Acme/AppTypes
  unit PressureUnit: display-name=kPa
  app type Pressure: category=VALUE, compu {phys=raw*0.25}, range phys 0..250, unit=kPa
package /Acme/Mappings
  data type mapping set TypeMaps: data-type-map{application-data-type=Pressure, implementation-data-type=RawPressure}
package /Acme/Interfaces
  sender receiver interface IReadings
    data count: type=Counter
    data pressure: type=Pressure
package /Acme/Components
  application sw component type ReadingsSwc
    provide port pReadings: provided-interface=IReadings
