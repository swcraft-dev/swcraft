AUTOSAR XML (schema 4-2-2)
package /Acme/Left/Types
  base type Octet: category=FIXED_LENGTH, base-type-size=8, base-type-encoding=NONE, native-declaration=uint8
  impl type Level: category=VALUE, base-type=Types/Octet
package /Acme/Right/Types
  base type Octet: category=FIXED_LENGTH, base-type-size=16, base-type-encoding=NONE, native-declaration=uint8
package /Acme/Chassis/Interfaces
  sender receiver interface ILevel
    data level: type=Level
package /Acme/Chassis/Components
  application sw component type LevelSwc
    provide port pLevel: provided-interface=ILevel
