AUTOSAR XML (schema 4-2-2)
package /Acme/BaseTypes
  base type Word: category=FIXED_LENGTH, base-type-size=16, base-type-encoding=NONE, native-declaration=uint16
package /Acme/ImplTypes
  impl type RawTemp: category=VALUE, base-type=Word
package /Acme/AppTypes
  unit TempUnit: display-name=deg C
  app type Temperature: category=VALUE, compu {phys=raw*0.1-40}, range phys -40..125, unit=deg C
package /Acme/Mappings
  data type mapping set TypeMaps: data-type-map{application-data-type=Temperature, implementation-data-type=RawTemp}
package /Acme/Interfaces
  sender receiver interface ITemperature
    data temperature: type=Temperature
package /Acme/Components
  application sw component type TempSwc
    provide port pTemp: provided-interface=ITemperature
