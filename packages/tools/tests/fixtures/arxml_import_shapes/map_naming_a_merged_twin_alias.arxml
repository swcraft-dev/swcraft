AUTOSAR XML (schema 4-2-2)
package /Acme/BaseTypes
  base type Word: category=FIXED_LENGTH, base-type-size=16, base-type-encoding=NONE, native-declaration=uint16
package /Acme/ImplTypes
  impl type Speed: category=VALUE, base-type=Word
package /Acme/ImplTypesCopy
  impl type Speed: category=VALUE, base-type=Word
package /Acme/AppTypes
  unit SpeedUnit: display-name=km/h
  app type Speed: category=VALUE, unit=km/h
package /Acme/Mappings
  data type mapping set TypeMaps: data-type-map{application-data-type=Speed, implementation-data-type=ImplTypesCopy/Speed}
package /Acme/Interfaces
  sender receiver interface ISpeed
    data speed: type=Speed
package /Acme/Components
  application sw component type SpeedSwc
    provide port pSpeed: provided-interface=ISpeed
