AUTOSAR XML (schema 4-2-2)
package /Acme/Chassis/Types
  impl type PlatformAlias: implementation-data-type=uint8
package /Acme/Chassis/Interfaces
  sender receiver interface IPlatformSample
    data sample: type=PlatformAlias
