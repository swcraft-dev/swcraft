AUTOSAR XML (schema 4-2-2)
package /Acme/BaseTypes
  base type Word: category=FIXED_LENGTH, base-type-size=16, base-type-encoding=NONE, native-declaration=uint16
package /Acme/ImplTypes
  impl type Level: category=VALUE, base-type=Word
package /Acme/AppTypes
  app type Level: category=VALUE
package /Acme/Mappings
  data type mapping set TypeMaps: data-type-map{application-data-type=Level, implementation-data-type=Level}
package /Acme/Interfaces
  sender receiver interface ILevel
    data level: type=Level
package /Acme/Components
  application sw component type LevelSwc
    provide port pLevel: provided-interface=ILevel
