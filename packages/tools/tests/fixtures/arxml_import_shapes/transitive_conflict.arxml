AUTOSAR XML (schema 4-2-2)
package /Acme/Left/Types
  base type Word16: category=FIXED_LENGTH, base-type-size=16, base-type-encoding=NONE, native-declaration=uint16
  impl type Distance: category=VALUE, base-type=Types/Word16
package /Acme/Right/Types
  base type Word16: category=FIXED_LENGTH, base-type-size=32, base-type-encoding=NONE, native-declaration=uint16
  impl type Distance: category=VALUE, base-type=Types/Word16
