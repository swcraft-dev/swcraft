AUTOSAR XML (schema 4-2-2)
package /Acme/Chassis/Types
  base type Octet: category=FIXED_LENGTH, base-type-size=8, base-type-encoding=NONE, native-declaration=uint8
  impl type SampleValue: category=VALUE, base-type=Octet
  impl type SampleAlias: implementation-data-type=BaseSample
