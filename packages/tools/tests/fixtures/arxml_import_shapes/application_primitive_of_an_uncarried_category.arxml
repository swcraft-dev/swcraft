AUTOSAR XML (schema 4-2-2)
package /Acme/Types
  base type Word: category=FIXED_LENGTH, base-type-size=16, base-type-encoding=NONE, native-declaration=uint16
  impl type RawCount: category=VALUE, base-type=Word
  unit Rpm: display-name=rpm
  app type Cadence: category=BOOLEAN, unit=rpm
package /Acme/Mappings
  data type mapping set FlagMaps: data-type-map{application-data-type=Cadence, implementation-data-type=RawCount}
package /Acme/Interfaces
  sender receiver interface ICadence
    data cadence: type=Cadence
package /Acme/Components
  application sw component type CadenceSource
    provide port pCadence: provided-interface=ICadence
    behavior CadenceSourceBehavior: data-type-mapping=FlagMaps, handle-termination-and-restart=NO-SUPPORT
  application sw component type CadenceSink
    require port rCadence: required-interface=ICadence
    behavior CadenceSinkBehavior: data-type-mapping=FlagMaps, handle-termination-and-restart=NO-SUPPORT
  composition sw component type Root
    component source: type=CadenceSource
    component sink: type=CadenceSink
