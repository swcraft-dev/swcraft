AUTOSAR XML (schema 4-2-2)
standard types defined: uint8, uint16
package /Acme/Chassis/Types
  4 x impl type:
    uint16_impl: category=VALUE, base-type=uint16
    WheelTravelRange_impl: implementation-data-type=uint16_impl  # Alias-over-implementation-type example: reuses uint16_impl's representation (anonymized fixture).
    BrakeModeEnum: category=VALUE, base-type=uint8
    DoorStateEnum: category=VALUE, base-type=uint8  # Raw latch-sensor byte, unrelated to the application-level DoorStateEnum (anonymized fixture; deliberate name collision).
package /Acme/Chassis/ApplicationTypes
  app type BrakeModeEnum: category=VALUE, compu {0=OFF, 1=ACTIVE, 2=FAULT}
  app type DoorStateEnum: category=VALUE, compu {0=CLOSED, 1=OPEN}  # Application-level door latch state, unrelated to the implementation-level DoorStateEnum (anonymized fixture; deliberate name collision).
  app type PressureRatio: category=VALUE, compu {phys=raw*0.01}
  application record data type WheelCornerStatus: category=STRUCTURE  # Per-corner wheel status record (anonymized fixture).
    application record element pressure: category=VALUE, type=PressureRatio
    application record element mode: category=VALUE, type=BrakeModeEnum
  application array data type WheelCornerStatusArray: category=ARRAY  # Fixed-size array of per-corner wheel status records, one per wheel (anonymized fixture).
    element corner: category=VALUE, type=WheelCornerStatus, max-number-of-elements=4
package /Acme/Chassis/DataTypeMappingSets
  data type mapping set Acme_Chassis_DataTypeMapping: data-type-map{application-data-type=BrakeModeEnum, implementation-data-type=BrakeModeEnum}
