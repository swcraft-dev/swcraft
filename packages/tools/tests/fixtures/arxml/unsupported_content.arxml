AUTOSAR XML (schema 4-2-2)
standard types defined: uint8
package /Acme/Chassis/Constants
  constant specification DefaultBrakeBias: value-spec=DefaultBrakeBias:0
package /Acme/Chassis/DataTypes
  impl type uint8_impl: category=VALUE, base-type=uint8
package /Acme/Chassis/Interfaces
  sender receiver interface IDiagnosticChannel: is-service=true
    data rawFrame: type=uint8_impl
package /Acme/Chassis/Components
  application sw component type DiagnosticBridgeSwc
    provide/require port prDiagnosticChannel: provided-interface=IDiagnosticChannel, required-interface=IDiagnosticChannel
  acme export metadata RhapsodyExportMeta: acme-tool-version=1.0.0, acme-source-project=AnonymizedFixtureProject
